## conf/layer.conf
```bitbake
# We have a conf and classes directory, add to BBPATH
BBPATH .= ":${LAYERDIR}"

# We have recipes-* directories, add to BBFILES
BBFILES += "${LAYERDIR}/recipes-*/*/*.bb \
            ${LAYERDIR}/recipes-*/*/*.bbappend"

BBFILE_COLLECTIONS += "meta-tn-wifi"
BBFILE_PATTERN_meta-tn-wifi = "^${LAYERDIR}/"
BBFILE_PRIORITY_meta-tn-wifi = "8"

LAYERDEPENDS_meta-tn-wifi = "core"
LAYERSERIES_COMPAT_meta-tn-wifi = "kirkstone"
```
